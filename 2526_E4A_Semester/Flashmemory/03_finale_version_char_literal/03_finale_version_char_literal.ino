#include <Arduino.h>
#include <avr/pgmspace.h>

const uint8_t font[] PROGMEM = {

    0x00, 0x00, 0x00, 0x00, 0x00, // 0x00
    0x3E, 0x5B, 0x4F, 0x5B, 0x3E, // 0x01
    0x3E, 0x6B, 0x4F, 0x6B, 0x3E, // 0x02
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    0x1E, 0xA1, 0xA1, 0x61, 0x12, // 0x80
    // 0x81 bis 0x9F: Platzhalter / Blockgrafik
    0xFF, 0x81, 0x01, 0x81, 0xFF, // 0x81
    0xFF, 0x81, 0x01, 0x81, 0xFF, // 0x82
    0xFF, 0x81, 0x01, 0x81, 0xFF, // 0x83
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    0x00, 0x08, 0xFC, 0x48, 0x00, // 0xFF

};

constexpr uint8_t FONT_BREITE = 5;
constexpr uint8_t FONT_HOEHE  = 8;

static_assert(sizeof(font) % FONT_BREITE == 0,
              "Font-Array hat keine gueltige Breite.");

void setup()
{
  Serial.begin(9600);

  uint8_t zeichen[FONT_BREITE];

  Serial.println(F("Start: Font im Flash, einzelne Zeichen als char-Literale"));
  Serial.print(F("Anzahl Zeichen: "));
  Serial.println(sizeof(font) / FONT_BREITE);
  Serial.println();

  for (uint16_t k = 0; k < sizeof(font) / FONT_BREITE; ++k)
  {
    for (uint8_t i = 0; i < FONT_BREITE; ++i)
    {
      zeichen[i] = pgm_read_byte(font + k * FONT_BREITE + i);
    }

    Serial.print(k);
    Serial.println(F(".tes Zeichen:"));

    for (uint8_t j = 0; j < FONT_HOEHE; ++j)
    {
      for (uint8_t i = 0; i < FONT_BREITE; ++i)
      {
        if (zeichen[i] & 0x01) Serial.print('X');
        else                   Serial.print(' ');

        zeichen[i] >>= 1;
      }
      Serial.print('\n');
    }

    Serial.print('\n');
    Serial.print('\n');
    Serial.print('\n');
  }
}

void loop()
{
}
